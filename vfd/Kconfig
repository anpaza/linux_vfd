## vfd/Kconfig
```kconfig
#
# VFD configuration
#

config VFD_ENABLE
	tristate "7-segment LED display support"
	default n
	help
	  Say Y here if you want to use the driver for 7-segment
	  LED displays connected to a LED display driver IC like
	  SM1628, FD628 etc.

	  Communication with the driver IC is done via bit-banging
	  several GPIOs.

	  This driver also optionaly provides input via buttons
	  connected to same IC.

	  To compile this driver as a module, choose M here: the
	  module will be called vfd.

config VFD_NO_KEY_INPUT
	tristate "No key input from IC"
	default n
	depends on VFD_ENABLE
	help
	  Select this option if you don't have any buttons
	  connected to the driver IC. The driver will not
	  create any input device in this case.

choice
	prompt "Display driver IC backend"
	default VFD_PT6964
	depends on VFD_ENABLE

config VFD_PT6964
	bool "PT6964, SM1628, TM1623, FD268"
	help
	  PT6964, SM1628, TM1623 or FD268 is used to drive the 7-segment LED displays

endchoice

choice
	prompt "PT6964 display-to-IC connection scheme"
	default VFD_PT6964_X92
	depends on VFD_ENABLE && VFD_PT6964

config VFD_PT6964_X92
	bool "X92 LED display"
	help
	  Connection scheme used on X92 AMlogic S912-based TV boxes

endchoice
```
