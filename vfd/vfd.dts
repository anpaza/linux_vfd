// Example device configuration in platform DTS

	meson-vfd {
		compatible = "amlogic,aml_vfd";
		dev_name = "meson-vfd";
		status = "okay";
		gpios = <&gpio GPIODV_17 GPIO_ACTIVE_HIGH>,  /* STB */
			<&gpio GPIODV_16 GPIO_ACTIVE_HIGH>,  /* CLK */
			<&gpio GPIODV_15 GPIO_ACTIVE_HIGH>;  /* DI/DO */
		/* [scan code] [linux key code] */
		key_codes = /bits/ 16
			    <0x02 KEY_POWER
			     0x07 KEY_VOLUMEDOWN
			     0x01 KEY_VOLUMEUP
			     0x05 KEY_MENU
			     0x04 KEY_CHANNELUP
			     0x06 KEY_CHANNELDOWN
			     0x00 KEY_ENTER>;
		/* dot LED names */
		dot_names = "APPS",
			    "SETUP",
			    "USB",
			    "CARD",
			    ":",
			    "HDMI",
			    "CVBS";
		/* dot LED <16_bit_word bit_number> in raw display buffer ('overlay') */
		dot_bits = /bits/ 8
			   <0 3
			    1 3
			    2 3
			    3 3
			    4 3
			    5 3
			    6 3>;
	};
